## Config.in
```kconfig
source "$BR2_EXTERNAL_MESHTASTIC_PATH/package/meta-cli-tools/Config.in"

source "$BR2_EXTERNAL_MESHTASTIC_PATH/package/compat-python-pip/Config.in.host"
source "$BR2_EXTERNAL_MESHTASTIC_PATH/package/compat-python-poetry-core/Config.in.host"

source "$BR2_EXTERNAL_MESHTASTIC_PATH/package/compat-python-click/Config.in.host"
source "$BR2_EXTERNAL_MESHTASTIC_PATH/package/python-tabulate/Config.in"
source "$BR2_EXTERNAL_MESHTASTIC_PATH/package/python-tabulate/Config.in.host"
source "$BR2_EXTERNAL_MESHTASTIC_PATH/package/python-platformio/Config.in.host"
source "$BR2_EXTERNAL_MESHTASTIC_PATH/package/liborcania/Config.in"
source "$BR2_EXTERNAL_MESHTASTIC_PATH/package/libyder/Config.in"
source "$BR2_EXTERNAL_MESHTASTIC_PATH/package/libulfius/Config.in"
source "$BR2_EXTERNAL_MESHTASTIC_PATH/package/meshtasticd/Config.in"
source "$BR2_EXTERNAL_MESHTASTIC_PATH/package/meshtasticd-web/Config.in"

source "$BR2_EXTERNAL_MESHTASTIC_PATH/package/python-dotmap/Config.in"
source "$BR2_EXTERNAL_MESHTASTIC_PATH/package/python-pypubsub/Config.in"
source "$BR2_EXTERNAL_MESHTASTIC_PATH/package/python-print-color/Config.in"
source "$BR2_EXTERNAL_MESHTASTIC_PATH/package/python-meshtastic/Config.in"

source "$BR2_EXTERNAL_MESHTASTIC_PATH/package/python-geographiclib/Config.in"
source "$BR2_EXTERNAL_MESHTASTIC_PATH/package/python-geopy/Config.in"
source "$BR2_EXTERNAL_MESHTASTIC_PATH/package/python-ephem/Config.in"
source "$BR2_EXTERNAL_MESHTASTIC_PATH/package/python-maidenhead/Config.in"
source "$BR2_EXTERNAL_MESHTASTIC_PATH/package/python-openmeteo-sdk/Config.in"
source "$BR2_EXTERNAL_MESHTASTIC_PATH/package/python-openmeteo-requests/Config.in"
source "$BR2_EXTERNAL_MESHTASTIC_PATH/package/python-meshing-around/Config.in"

source "$BR2_EXTERNAL_MESHTASTIC_PATH/package/lichee-cvi-pinmux/Config.in"
```

## package/compat-python-click/Config.in.host
```kconfig
config BR2_PACKAGE_HOST_COMPAT_PYTHON_CLICK
	bool "host compat-python-click"
	help
	  A simple wrapper around optparse for powerful command line
	  utilities.

	  https://pypi.python.org/pypi/click

comment "`python-click` host package. Couldn't re-use the same package name as upstream."
```

## package/compat-python-pip/Config.in.host
```kconfig
config BR2_PACKAGE_HOST_COMPAT_PYTHON_PIP
	bool "host compat-python-pip"
	depends on !BR2_PACKAGE_HOST_PYTHON_PIP
	default y if !BR2_PACKAGE_HOST_PYTHON_PIP
	help
	  The PyPA recommended tool for installing Python packages.
	  Host-package backported from buildroot 2023.05.x

	  https://pip.pypa.io/

comment "`python-poetry-core` backported for Buildroot versions older than 2023.05"
```

## package/compat-python-poetry-core/Config.in.host
```kconfig
config BR2_PACKAGE_HOST_COMPAT_PYTHON_POETRY_CORE
	bool "host compat-python-poetry-core"
	depends on !BR2_PACKAGE_HOST_PYTHON_POETRY_CORE
	default y if !BR2_PACKAGE_HOST_PYTHON_POETRY_CORE
	help
	  poetry-core, backported from buildroot 2024.08.x

	  https://github.com/buildroot/buildroot/tree/2024.08.x/package/python-poetry-core

comment "`python-poetry-core` host package backported for Buildroot versions older than 2024.05"
```

## package/liborcania/Config.in
```kconfig
config BR2_PACKAGE_LIBORCANIA
	bool "liborcania"
	help
	  A collection of C utility functions and structures.
	  It is designed to be simple to use, fast, and scalable.
	  Used by ulfius.
```

## package/libulfius/Config.in
```kconfig
config BR2_PACKAGE_LIBULFIUS
	bool "libulfius"
	select BR2_PACKAGE_LIBMICROHTTPD
	select BR2_PACKAGE_LIBORCANIA
	help
	  Web Framework to build REST APIs in C, using Jansson for JSON
	  and Libmicrohttpd for the HTTP daemon.
	  It is designed to be simple to use, fast, and scalable.

if BR2_PACKAGE_LIBULFIUS

config BR2_PACKAGE_LIBULFIUS_JANSSON
	bool "jansson support"
	default y
	select BR2_PACKAGE_JANSSON
	help
	  Enable support for Jansson JSON library

config BR2_PACKAGE_LIBULFIUS_CURL
	bool "libcurl support"
	default y
	select BR2_PACKAGE_LIBCURL
	select BR2_PACKAGE_LIBCURL_GNUTLS if BR2_PACKAGE_GNUTLS
	help
	  Enable support for libcurl

config BR2_PACKAGE_LIBULFIUS_GNUTLS
	bool "gnutls support"
	default y
	select BR2_PACKAGE_GNUTLS
	select BR2_PACKAGE_GNUTLS_OPENSSL if BR2_PACKAGE_OPENSSL
	select BR2_PACKAGE_LIBMICROHTTPD_SSL
	help
	  Enable support for gnutls

config BR2_PACKAGE_LIBULFIUS_WEBSOCKET
	bool "websockets support"
	default y
	select BR2_PACKAGE_ZLIB
	select BR2_PACKAGE_LIBWEBSOCKETS
	help
	  Enable support for libwebsockets

config BR2_PACKAGE_LIBULFIUS_JOURNALD
	bool "journald support"
	depends on BR2_PACKAGE_SYSTEMD
	default y if BR2_PACKAGE_SYSTEMD
	help
	  Enable support for journald

config BR2_PACKAGE_LIBULFIUS_YDER
	bool "yder support"
	default y
	select BR2_PACKAGE_LIBYDER
	help
	  Enable support for yder

config BR2_PACKAGE_LIBULFIUS_UWSC
	bool "build uwsc binary"
	default y
	help
	  Build ulfius websocket client binary

endif
```

## package/libyder/Config.in
```kconfig
config BR2_PACKAGE_LIBYDER
	bool "libyder"
	select BR2_PACKAGE_LIBORCANIA
	help
	  Simple and easy to use logging library.
	  You can log messages to the console, a file, Syslog,
	  journald or a callback function.

if BR2_PACKAGE_LIBYDER

config BR2_PACKAGE_LIBYDER_JOURNALD
	bool "journald support"
	depends on BR2_PACKAGE_SYSTEMD
	default y if BR2_PACKAGE_SYSTEMD
	help
	  Enable support for journald

endif
```

## package/lichee-cvi-pinmux/Config.in
```kconfig
config BR2_PACKAGE_LICHEE_CVI_PINMUX
	bool "cvi-pinmux (licheerv_nano)"
	depends on !BR2_PACKAGE_CVI_PINMUX
	help
	  CVI Pin Multiplexing.
	  Ported from milkv-duo repo for licheerv_nano.
	  Do not select on the milkv-duo platform.

if BR2_PACKAGE_LICHEE_CVI_PINMUX

choice
	prompt "Cvi pin multiplexing"
	default BR2_PACKAGE_LICHEE_CVI_PINMUX_SG200X

config BR2_PACKAGE_LICHEE_CVI_PINMUX_CV180X
	bool "CV180X"
	help
	  pinmux for cv180x.

config BR2_PACKAGE_LICHEE_CVI_PINMUX_SG200X
	bool "SG200X"
	help
	  pinmux for sg200x.

endchoice

endif
```

## package/meshtasticd-web/Config.in
```kconfig
config BR2_PACKAGE_MESHTASTICD_WEB
	bool "meshtasticd-web"
	depends on BR2_TOOLCHAIN_HAS_THREADS
	depends on BR2_PACKAGE_MESHTASTICD
	select BR2_PACKAGE_OPENSSL
	select BR2_PACKAGE_LIBOPENSSL
	select BR2_PACKAGE_LIBORCANIA
	select BR2_PACKAGE_LIBYDER
	select BR2_PACKAGE_LIBULFIUS
	select BR2_PACKAGE_LIBULFIUS_JANSSON
	select BR2_PACKAGE_LIBULFIUS_GNUTLS
	select BR2_PACKAGE_LIBULFIUS_YDER
	default y
	help
	  meshtasticd web interface

	  https://github.com/meshtastic/web
```

## package/meshtasticd/Config.in
```kconfig
config BR2_PACKAGE_MESHTASTICD
	bool "meshtasticd"
	default y
	depends on BR2_TOOLCHAIN_GCC_AT_LEAST_7 # C++17
	select BR2_PACKAGE_HOST_PYTHON3
	select BR2_PACKAGE_HOST_PYTHON3_SSL
	select BR2_PACKAGE_HOST_PYTHON_CLICK_HACK
	select BR2_PACKAGE_HOST_PYTHON_SEMANTIC_VERSION
	select BR2_PACKAGE_HOST_PYTHON_REQUESTS
	select BR2_PACKAGE_HOST_PYTHON_TABULATE
	select BR2_PACKAGE_HOST_PYTHON_SERIAL
	select BR2_PACKAGE_HOST_PYTHON_PYELFTOOLS
	select BR2_PACKAGE_HOST_PYTHON_PLATFORMIO
	select BR2_PACKAGE_LIBGPIOD
	select BR2_PACKAGE_LIBGPIOD_TOOLS
	select BR2_PACKAGE_YAML_CPP
	select BR2_PACKAGE_BLUEZ5_UTILS_HEADERS
	select BR2_PACKAGE_ARGP_STANDALONE if BR2_TOOLCHAIN_USES_UCLIBC || BR2_TOOLCHAIN_USES_MUSL
	help
	  meshtasticd portduino

	  https://meshtastic.org/docs/software/linux-native/
```

## package/meta-cli-tools/Config.in
```kconfig
# Meta-Package
config BR2_PACKAGE_META_CLI_TOOLS
	bool "meta-cli-tools"
	default y
	select BR2_PACKAGE_UTIL_LINUX_BINARIES
	select BR2_PACKAGE_BASH
	select BR2_PACKAGE_BASH_COMPLETION
	select BR2_PACKAGE_GREP
	select BR2_PACKAGE_SED
	select BR2_PACKAGE_HTOP
	select BR2_PACKAGE_NANO
	select BR2_PACKAGE_LESS
	select BR2_PACKAGE_WGET
	select BR2_PACKAGE_ZIP
	select BR2_PACKAGE_UNZIP
	help
	  Meta-Package that selects common CLI tools
	  These tools are not required for meshtasticd to run,
	  but are useful for debugging and development.

comment "meta-package that selects common CLI tools"
```

## package/python-click-hack/Config.in.host
```kconfig
config BR2_PACKAGE_HOST_PYTHON_CLICK_HACK
	bool "host python-click-hack"
	help
	  A simple wrapper around optparse for powerful command line
	  utilities.

	  https://pypi.python.org/pypi/click

comment "`python-click` host package. Couldn't re-use the same package name as upstream."
```

## package/python-click/Config.in.host
```kconfig
config BR2_PACKAGE_HOST_PYTHON_CLICK
	bool "host python-click"
	help
	  A simple wrapper around optparse for powerful command line
	  utilities.

	  https://pypi.python.org/pypi/click
```

## package/python-dotmap/Config.in
```kconfig
config BR2_PACKAGE_PYTHON_DOTMAP
	bool "python-dotmap"
	help
	  A dot-access dict subclass

	  https://pypi.org/project/dotmap
```

## package/python-ephem/Config.in
```kconfig
config BR2_PACKAGE_PYTHON_EPHEM
	bool "python-ephem"
	help
	  Package for performing high-precision astronomy computations.

	  https://pypi.org/project/ephem
```

## package/python-geographiclib/Config.in
```kconfig
config BR2_PACKAGE_PYTHON_GEOGRAPHICLIB
	bool "python-geographiclib"
	help
	  Python implementation of the geodesic routines in GeographicLib

	  https://pypi.org/project/geographiclib
```

## package/python-geopy/Config.in
```kconfig
config BR2_PACKAGE_PYTHON_GEOPY
	bool "python-geopy"
	select BR2_PACKAGE_PYTHON_REQUESTS
	select BR2_PACKAGE_PYTHON_GEOGRAPHICLIB
	help
	  A Python client for several popular geocoding web services

	  https://pypi.org/project/geopy
```

## package/python-maidenhead/Config.in
```kconfig
config BR2_PACKAGE_PYTHON_MAIDENHEAD
	bool "python-maidenhead"
	help
	  Provides a simple, yet effective location hashing algorithm

	  https://pypi.org/project/maidenhead
```

## package/python-meshing-around/Config.in
```kconfig
# requirements that still need to be packaged:
# retry_requests
# dadjokes
# wikipedia

config BR2_PACKAGE_PYTHON_MESHING_AROUND
	bool "python-meshing-around"
	# default y
	select BR2_PACKAGE_PYTHON_MESHTASTIC
	select BR2_PACKAGE_PYTHON_PYPUBSUB
	select BR2_PACKAGE_PYTHON_REQUESTS
	select BR2_PACKAGE_PYTHON_BEAUTIFULSOUP4
	select BR2_PACKAGE_PYTHON_SCHEDULE
	select BR2_PACKAGE_PYTHON_GEOPY
	select BR2_PACKAGE_PYTHON_EPHEM # solar module
	select BR2_PACKAGE_PYTHON_MAIDENHEAD
	select BR2_PACKAGE_PYTHON_OPENMETEO_REQUESTS
	# select BR2_PACKAGE_PYTHON_NUMPY if BR2_PACKAGE_PYTHON_NUMPY_ARCH_SUPPORTS # wx_meteo module
	help
	  Mesh Bot for Network Testing and BBS Activities

	  https://github.com/SpudGunMan/meshing-around
```

## package/python-meshtastic-channel-link/Config.in
```kconfig
config BR2_PACKAGE_PYTHON_MESHTASTIC_CHANNEL_LINK
	bool "python-meshtastic-channel-link"
	# default y
	select BR2_PACKAGE_PYTHON_MESHTASTIC
	select BR2_PACKAGE_PYTHON_PAHO_MQTT
	select BR2_PACKAGE_PYTHON_CRYPTOGRAPHY
	help
	  A Python script using MQTT to bridge Meshtastic
	  networks using different modem settings.

	  https://github.com/pdxlocations/ChannelLink-for-Meshtastic
```

## package/python-meshtastic-tc2-bbs/Config.in
```kconfig
config BR2_PACKAGE_PYTHON_MESHTASTIC_TC2_BBS
	bool "python-meshtastic-tc2-bbs"
	select BR2_PACKAGE_PYTHON_MESHTASTIC
	select BR2_PACKAGE_PYTHON_PYPUBSUB
	help
	  The TC²-BBS system integrated with Meshtastic devices.
	  This system allows for message handling, bulletin boards,
	  mail systems, and a channel directory.

	  https://github.com/TheCommsChannel/TC2-BBS-mesh
```

## package/python-meshtastic/Config.in
```kconfig
config BR2_PACKAGE_PYTHON_MESHTASTIC
	bool "python-meshtastic"
	select BR2_PACKAGE_PYTHON_REQUESTS # runtime
	select BR2_PACKAGE_PYTHON_PROTOBUF # runtime
	select BR2_PACKAGE_PYTHON_SERIAL # runtime
	select BR2_PACKAGE_PYTHON_PEXPECT # runtime
	select BR2_PACKAGE_PYTHON_PYQRCODE # runtime
	select BR2_PACKAGE_PYTHON_PYYAML # runtime
	select BR2_PACKAGE_PYTHON_WEBENCODINGS # runtime
	select BR2_PACKAGE_PYTHON_PYPARSING # runtime
	select BR2_PACKAGE_PYTHON_BLEAK # runtime
	select BR2_PACKAGE_PYTHON_DOTMAP # runtime
	select BR2_PACKAGE_PYTHON_TABULATE # runtime
	select BR2_PACKAGE_PYTHON_PYPUBSUB # runtime
	select BR2_PACKAGE_PYTHON_PRINT_COLOR # runtime
	help
	  A Python client for use with Meshtastic devices. This small library (and example application) provides an easy API for sending and receiving messages over mesh radios.
	  It also provides access to any of the operations/data available in the device user interface or the Android application.
	  Events are delivered using a publish-subscribe model, and you can subscribe to only the message types you are interested in.

	  https://pypi.python.org/pypi/meshtastic
```

## package/python-openmeteo-requests/Config.in
```kconfig
config BR2_PACKAGE_PYTHON_OPENMETEO_REQUESTS
	bool "python-openmeteo-requests"
	select BR2_PACKAGE_PYTHON_OPENMETEO_SDK
	help
	  An API client to get weather data from the Open-Meteo Weather API
	  based on the Python library requests.

	  https://pypi.org/project/openmeteo-requests
```

## package/python-openmeteo-sdk/Config.in
```kconfig
config BR2_PACKAGE_PYTHON_OPENMETEO_SDK
	bool "python-openmeteo-sdk"
	select BR2_PACKAGE_PYTHON_FLATBUFFERS
	help
	  Open-Meteo SDK Schema Files

	  https://pypi.org/project/openmeteo-sdk
```

## package/python-platformio/Config.in.host
```kconfig
config BR2_PACKAGE_HOST_PYTHON_PLATFORMIO
	bool "host python-platformio"
	select BR2_PACKAGE_HOST_PYTHON3
	select BR2_PACKAGE_HOST_PYTHON3_SSL
	select BR2_PACKAGE_HOST_COMPAT_PYTHON_CLICK
	select BR2_PACKAGE_HOST_PYTHON_SEMANTIC_VERSION
	select BR2_PACKAGE_HOST_PYTHON_REQUESTS
	select BR2_PACKAGE_HOST_PYTHON_TABULATE
	select BR2_PACKAGE_HOST_PYTHON_SERIAL
	select BR2_PACKAGE_HOST_PYTHON_PYELFTOOLS
	help
	  PlatformIO IDE

	  https://platformio.org/
```
