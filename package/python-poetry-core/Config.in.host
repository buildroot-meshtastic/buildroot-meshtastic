## package/python-poetry-core/Config.in.host
```kconfig
config BR2_PACKAGE_HOST_PYTHON_POETRY_CORE
	bool "host python-poetry-core"
	help
	  poetry-core, backported from buildroot 2024.08.x

	  https://github.com/buildroot/buildroot/tree/2024.08.x/package/python-poetry-core
```

## package/python-print-color/Config.in
```kconfig
config BR2_PACKAGE_PYTHON_PRINT_COLOR
	bool "python-print-color"
	help
      A minimalist approach to terminal color printing in Python

	  https://pypi.python.org/pypi/print-color
```

## package/python-pypubsub/Config.in
```kconfig
config BR2_PACKAGE_PYTHON_PYPUBSUB
	bool "python-pypubsub"
	help
      Provides a publish-subscribe API to facilitate event-based
      or message-based architecture in a single-process application.

	  https://pypi.python.org/pypi/pypubsub
```

## package/python-tabulate/Config.in
```kconfig
config BR2_PACKAGE_PYTHON_TABULATE
	bool "python-tabulate"
	help
	  Pretty-print tabular data in Python, a library and
	  a command-line utility.

	  https://pypi.python.org/pypi/tabulate
```

## package/python-tabulate/Config.in.host
```kconfig
config BR2_PACKAGE_HOST_PYTHON_TABULATE
	bool "host python-tabulate"
	help
	  Pretty-print tabular data in Python, a library and
	  a command-line utility.

	  https://pypi.python.org/pypi/tabulate
```
